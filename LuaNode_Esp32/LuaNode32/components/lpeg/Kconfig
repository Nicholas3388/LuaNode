## LuaNode_Esp32/LuaNode32/components/lpeg/Kconfig
```kconfig
menu "lpeg"

config LPEG_ENABLE
    bool "Enable lpeg"
    default "y"
    help
        For lpeg.

endmenu
```

## LuaNode_Esp32/LuaNode32/components/lua/Kconfig
```kconfig
menu "LUA"

config LUA_ENABLE
    bool "Enable lua"
    default "y"
    help
        For lua script.

endmenu
```

## LuaNode_Esp32/LuaNode32/components/modules/Kconfig
```kconfig
menu "MODULES"

config MODULES_ENABLE
    bool "Enable modules"
    default "y"
    help
        For modules.

endmenu
```

## LuaNode_Esp32/LuaNode32/components/mydriver/Kconfig
```kconfig
menu "DRIVER"

config DRIVER_ENABLE
    bool "Enable driver"
    default "y"
    help
        For driver.

endmenu
```

## LuaNode_Esp32/LuaNode32/components/mylibc/Kconfig
```kconfig
menu "MYLIBC"

config MYLIBC_ENABLE
    bool "Enable mylibc"
    default "y"
    help
        For mylibc.

endmenu
```

## LuaNode_Esp32/LuaNode32/components/platform/Kconfig
```kconfig
menu "PLATFORM"

config PLATFORM_ENABLE
    bool "Enable platform"
    default "y"
    help
        For platform.

endmenu
```

## LuaNode_Esp32/LuaNode32/components/uart/Kconfig
```kconfig
menu "UART"

config UART_ENABLE
    bool "Enable uart"
    default "y"
    help
        For uart.

endmenu
```

## LuaNode_Esp32/LuaNode32/components/utils/Kconfig
```kconfig
menu "UTILS"

config UTILS_ENABLE
    bool "Enable utils"
    default "y"
    help
        For utils.

endmenu
```
